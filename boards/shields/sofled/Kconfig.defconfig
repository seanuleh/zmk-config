## boards/shields/sofled/Kconfig.defconfig
```kconfig
# Copyright (c) 2020 Ryan Cross
# SPDX-License-Identifier: MIT

if SHIELD_SOFLED_DONGLE

config ZMK_KEYBOARD_NAME
    default "Sofle"

config ZMK_SPLIT_ROLE_CENTRAL
    default y

config ZMK_SPLIT
    default y

endif

if SHIELD_SOFLED_LEFT || SHIELD_SOFLED_RIGHT || SHIELD_SOFLED_DONGLE

 config ZMK_SPLIT
     default y

if ZMK_DISPLAY

config I2C
    default y

config SSD1306
    default y

config SOFLED_CUSTOM_STATUS_SCREEN
    bool "Sofle portrait custom status screen (Claude dude + WPM graph)"
    depends on ZMK_DISPLAY_STATUS_SCREEN_CUSTOM
    default y

config SOFLED_LINK_WIDGET
    bool "Dongle split-link panel (RSSI, drops, last drop reason)"
    depends on SHIELD_SOFLED_DONGLE && SOFLED_CUSTOM_STATUS_SCREEN
    default y

config SOFLED_LINK_RSSI
    bool "Poll per-half RSSI for the link panel (HCI read every 2 s)"
    depends on SOFLED_LINK_WIDGET
    select ZMK_LOW_PRIORITY_WORK_QUEUE
    select BT_CTLR_CONN_RSSI

endif # ZMK_DISPLAY

if LVGL

config LV_Z_VDB_SIZE
    default 64

config LV_DPI_DEF
    default 148

config LV_Z_BITS_PER_PIXEL
    default 1

choice LV_COLOR_DEPTH
    default LV_COLOR_DEPTH_1
endchoice

endif # LVGL

if ZMK_RGB_UNDERGLOW

config LED_STRIP
    default y
endif

endif
```
