## boards/shields/sofled/Kconfig.shield
```kconfig
# Copyright (c) 2020 Ryan Cross
# SPDX-License-Identifier: MIT

config SHIELD_SOFLED_LEFT
    def_bool $(shields_list_contains,sofled_left)

config SHIELD_SOFLED_RIGHT
    def_bool $(shields_list_contains,sofled_right)

config SHIELD_SOFLED_DONGLE
    def_bool $(shields_list_contains,sofled_dongle)
```
